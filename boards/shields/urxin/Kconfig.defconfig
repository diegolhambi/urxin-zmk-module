## boards/shields/urxin/Kconfig.defconfig
```kconfig
if SHIELD_URXIN_LEFT

config ZMK_KEYBOARD_NAME
    default "Urxin"

config ZMK_SPLIT_ROLE_CENTRAL
    default y

endif

if SHIELD_URXIN_LEFT || SHIELD_URXIN_RIGHT

config ZMK_SPLIT
    default y

endif
```

## boards/shields/urxin/Kconfig.shield
```kconfig
config SHIELD_URXIN_LEFT
    def_bool $(shields_list_contains,urxin_left)

config SHIELD_URXIN_RIGHT
    def_bool $(shields_list_contains,urxin_right)
```
